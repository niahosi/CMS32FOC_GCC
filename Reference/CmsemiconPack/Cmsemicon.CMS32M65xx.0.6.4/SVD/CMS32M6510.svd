# CMS32M6510 register map
Vendor: CMS; Series: CMS32M6510; File version: 1.2
CPU: CM0+ r0p1, little endian, no MPU, no FPU, VTOR, 2 interrupt priority bits
Registers are 32-bit, read-write, reset 0x0 unless marked. A register's access mark holds for its fields unless they carry their own. Offsets are from the block's base; [hi:lo] are bit positions; {n}, {i} and the like mark numbered series; 'fields as' and 'values as' point back to an identical list.

## PORT — Port functions
Base 0x40040000
0x00 P0 8-bit — Port register 0
0x01 P1 8-bit — Port register 1
0x02 P2 8-bit (reset mask 0x7F) — Port register 2
0x20 PM0 8-bit reset 0xFF — Port mode register 0
0x21 PM1 8-bit reset 0xFF (reset mask 0x7F) — Port mode register 1
0x22 PM2 8-bit reset 0xFF — Port mode register 2
0x30 PU0 8-bit — Pull-up resistor option register 0
0x31 PU1 8-bit reset 0x1 — Pull-up resistor option register 1
0x32 PU2 8-bit reset 0x40 (reset mask 0x7F) — Pull-up resistor option register 2
0x40 PD0 8-bit — Pull-down resistor option register 0
0x41 PD1 8-bit — Pull-down resistor option register 1
0x42 PD2 8-bit (reset mask 0x7F) — Pull-down resistor option register 2
0x50 POM0 8-bit — Port output mode register 0
0x51 POM1 8-bit — Port output mode register 1
0x52 POM2 8-bit (reset mask 0x7F) — Port output mode register 2
0x60 PMC0 8-bit reset 0xFF — Port mode control register 0
0x61 PMC1 8-bit reset 0xFF — Port mode control register 1
0x62 PMC2 8-bit reset 0xFF (reset mask 0x7F) — Port mode control register 2
{0x70+i} PSET{i} 8-bit (i=0..2) — Port set register {i}
{0x80+i} PCLR{i} 8-bit (i=0..2) — Port clear register {i}
{0x90+i} PREAD{i} 8-bit (i=0..2) — Port read register {i}
{0x800+2i} P{i:02}CFG 8-bit (i=0..7) — Alterate Output Function configuration register
  [3:0] CFG
    0=GPIO (Port used as GPIO); {v}=FUNC{v} (Port used as Function{v}) (v=1..7)
{0x7FC+2i} P{i}CFG 8-bit (i=10..16) — Alterate Output Function configuration register
  fields as P00CFG
{0x7F8+2i} P{i}CFG 8-bit (i=20..27) — Alterate Output Function configuration register
  fields as P00CFG
{0x860+i} INT{i}CFG 8-bit (i=0..3) — INT{i} alternate function pin configuration register
  [5:0] CFG
    {v}=P{v-1:02} (P{v-1:02} used as INT{i}) (v=1..8); {v}=P{v+1} (P{v+1} used as INT{i}) (v=9..15); {v}=P{v+4} (P{v+4} used as INT{i}) (v=16..23)
{0x864+i} TI{i:02}CFG 8-bit (i=0..3) — TI{i:02} alternate function pin configuration register
  [5:0] CFG
    {v}=P{v-1:02} (P{v-1:02} used as TI{i:02}) (v=1..8); {v}=P{v+1} (P{v+1} used as TI{i:02}) (v=9..15); {v}=P{v+4} (P{v+4} used as TI{i:02}) (v=16..23)
0x868 UARTRXDCFG 8-bit — UARTRXD alternate function pin configuration register
  [5:0] CFG
    4=P03 (P03 used as UARTRXD); 7=P06 (P06 used as UARTRXD)
0x869 EPWMBKINCFG 8-bit — EPWMBKIN alternate function pin configuration register
  [5:0] CFG
    1=P00 (P00 used as EPWMBKIN); 20=P24 (P25 used as EPWMBKIN); 23=P26 (P26 used as EPWMBKIN)
0x86A CCP0AINCFG 8-bit — CCP0AIN alternate function pin configuration register
  [5:0] CFG
    3=P02 (P02 used as CCP0AIN); 5=P04 (P04 used as CCP0AIN); 7=P06 (P06 used as CCP0AIN); 8=P07 (P07 used as CCP0AIN); 22=P26 (P26 used as CCP0AIN)
0x86B CCP0BINCFG 8-bit — CCP0BIN alternate function pin configuration register
  [5:0] CFG
    3=P02 (P02 used as CCP0BIN); 5=P04 (P04 used as CCP0BIN); 7=P06 (P06 used as CCP0BIN); 8=P07 (P07 used as CCP0BIN); 22=P26 (P26 used as CCP0BIN)
0x86C CCP1AINCFG 8-bit — CCP1AIN alternate function pin configuration register
  [5:0] CFG
    3=P02 (P02 used as CCP1AIN); 5=P04 (P04 used as CCP1AIN); 7=P06 (P06 used as CCP1AIN); 8=P07 (P07 used as CCP1AIN); 22=P26 (P26 used as CCP1AIN)
0x86D CCP1BINCFG 8-bit — CCP1BIN alternate function pin configuration register
  [5:0] CFG
    3=P02 (P02 used as CCP1BIN); 5=P04 (P04 used as CCP1BIN); 7=P06 (P06 used as CCP1BIN); 8=P07 (P07 used as CCP1BIN); 22=P26 (P26 used as CCP1BIN)
{0x870+i} P{i}TTLCFG 8-bit (i=0..2) — Port 0 TTL input select register
0x87B PMS 8-bit (reset mask 0x1) — Port mode select register
0x87D GDIDIS 8-bit (reset mask 0x1) — Global digital input disable register

## Notices in the file
Copyright (C) 2012-2014 ARM Limited. All rights reserved.
Purpose: System Viewer Description (SVD) Example (Schema Version 1.1)
This is a description of a none-existent and incomplete device
for demonstration purposes only.
Redistribution and use in source and binary forms, with or without
modification, are permitted provided that the following conditions are met:
- Redistributions of source code must retain the above copyright
notice, this list of conditions and the following disclaimer.
- Redistributions in binary form must reproduce the above copyright
notice, this list of conditions and the following disclaimer in the
documentation and/or other materials provided with the distribution.
- Neither the name of ARM nor the names of its contributors may be used
to endorse or promote products derived from this software without
specific prior written permission.
THIS SOFTWARE IS PROVIDED BY THE COPYRIGHT HOLDERS AND CONTRIBUTORS "AS IS"
AND ANY EXPRESS OR IMPLIED WARRANTIES, INCLUDING, BUT NOT LIMITED TO, THE
IMPLIED WARRANTIES OF MERCHANTABILITY AND FITNESS FOR A PARTICULAR PURPOSE
ARE DISCLAIMED. IN NO EVENT SHALL COPYRIGHT HOLDERS AND CONTRIBUTORS BE
LIABLE FOR ANY DIRECT, INDIRECT, INCIDENTAL, SPECIAL, EXEMPLARY, OR
CONSEQUENTIAL DAMAGES (INCLUDING, BUT NOT LIMITED TO, PROCUREMENT OF
SUBSTITUTE GOODS OR SERVICES; LOSS OF USE, DATA, OR PROFITS; OR BUSINESS
INTERRUPTION) HOWEVER CAUSED AND ON ANY THEORY OF LIABILITY, WHETHER IN
CONTRACT, STRICT LIABILITY, OR TORT (INCLUDING NEGLIGENCE OR OTHERWISE)
ARISING IN ANY WAY OUT OF THE USE OF THIS SOFTWARE, EVEN IF ADVISED OF THE
POSSIBILITY OF SUCH DAMAGE.
