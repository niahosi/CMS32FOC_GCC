/***********************************************************************************************************************
* Copyright (C) . All rights reserved.
***********************************************************************************************************************/

/***********************************************************************************************************************
* File Name    : main.c
* Version      :  
* Device(s)    : CMS32M6510
* Tool-Chain   : MDK(armcc)
* Description  : This file is a template.
* Creation Date: 2022/8/24
***********************************************************************************************************************/

/***********************************************************************************************************************
Macro Definitions
***********************************************************************************************************************/

/***********************************************************************************************************************
Includes
***********************************************************************************************************************/
#include <stdio.h>
#include "demo_spi.h"
#include "uart.h"
/***********************************************************************************************************************
Global variables and functions
***********************************************************************************************************************/
volatile uint32_t g_ticks;
volatile	uint32_t value=0;
volatile	uint32_t datasize=0;
uint32_t 	array[10]={0};

void delayMS(uint32_t n)
{
		g_ticks = n;
		while(g_ticks);
}

int main()
{
	uint32_t msCnt; 	// count value of 1ms
	uint32_t i,j;	    
//-----------------------------------------------------------------------
// Systick setting 
//-----------------------------------------------------------------------
	g_ticks = 1000; 	// 1000ms
	SystemCoreClockUpdate();
	msCnt = SystemCoreClock / 1000;
	SysTick_Config(msCnt); 


	SPI_Master_Mode();					/*设置SPI为主控模式*/		
	for(i=12000;i>0;i--)
		for(j=120;j>0;j--);

	value = SPI_M95256_Read_SFR(M95256_RDSR);		/*读取SFR*/
	SPI_M95256_Write(0x00, 0x48);					/*写数据*/
	for(i=655360;i>0;i--)
		for(j=10;j>0;j--);
	value = SPI_M95256_Read_Data(0x00);				/*读取数据*/

	while(1)
	{
		; 	
	}
}

/***********************************************************************************************************************
* Function Name: SysTick Handler
* Description  : Decreament the g_ticks value
* Arguments    : None
* Return Value : None
***********************************************************************************************************************/
void SysTick_Handler(void)
{
	UART_Lock(UART0);			//Lock when system used UART
	g_ticks--;
}


