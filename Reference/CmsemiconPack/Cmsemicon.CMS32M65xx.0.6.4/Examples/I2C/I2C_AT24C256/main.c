/***********************************************************************************************************************
* Copyright (C) . All rights reserved.
***********************************************************************************************************************/

/***********************************************************************************************************************
* File Name    : main.c
* Version      :  
* Device(s)    : CMS32M6510
* Tool-Chain   : MDK(armcc)
* Description  : This file is a template.
* Creation Date: 2022/8/24
***********************************************************************************************************************/

/***********************************************************************************************************************
Macro Definitions
***********************************************************************************************************************/

/***********************************************************************************************************************
Includes
***********************************************************************************************************************/
#include <stdio.h>
#include "demo_i2c.h"
#include "uart.h"
/***********************************************************************************************************************
Global variables and functions
***********************************************************************************************************************/
volatile uint32_t g_ticks;
volatile	uint32_t value=0;
volatile	uint32_t datasize=0;
uint32_t 	array[10]={0};

void delayMS(uint32_t n)
{
		g_ticks = n;
		while(g_ticks);
}

int main()
{
	uint32_t msCnt; 	// count value of 1ms

//-----------------------------------------------------------------------
// Systick setting 
//-----------------------------------------------------------------------
	g_ticks = 1000; 	// 1000ms
	SystemCoreClockUpdate();
	msCnt = SystemCoreClock / 1000;
	SysTick_Config(msCnt); 

	I2C_Master_Mode();								/*设置I2C主控模式*/		
	/*可在Debug模式中使用，发码格式与AT24C256的I2C协议一致，具体可参考AT24C256数据手册*/	
	At24c256_write_byte(0x10, 0x31);			/*写单个数据*/
	value = At24c256_read_byte(0x10);			/*读单个数据*/

	for(datasize =0; datasize<5; datasize++ )
	{
		At24c256_write_byte((0x11 + datasize), (0x32 + datasize));
	}
	datasize = 5;
	At24c256_read_str(0x11, array, datasize);	/*连续读数据*/

	while(1)
	{
		; 	
	}
}

/***********************************************************************************************************************
* Function Name: SysTick Handler
* Description  : Decreament the g_ticks value
* Arguments    : None
* Return Value : None
***********************************************************************************************************************/
void SysTick_Handler(void)
{
	UART_Lock(UART0);			//Lock when system used UART
	g_ticks--;
}


