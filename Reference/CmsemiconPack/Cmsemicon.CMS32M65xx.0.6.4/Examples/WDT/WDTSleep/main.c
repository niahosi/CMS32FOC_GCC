/***********************************************************************************************************************
* Copyright (C) . All rights reserved.
***********************************************************************************************************************/

/***********************************************************************************************************************
* File Name    : main.c
* Version      :  
* Device(s)    : CMS32M6510
* Tool-Chain   : MDK(armcc)
* Description  : This file is a template.
* Creation Date: 2022/8/24
***********************************************************************************************************************/

/***********************************************************************************************************************
Macro Definitions
***********************************************************************************************************************/

/***********************************************************************************************************************
Includes
***********************************************************************************************************************/
#include <stdio.h>
#include "wdt.h"
#include "gpio.h"
#include "uart.h"
/***********************************************************************************************************************
Global variables and functions
***********************************************************************************************************************/
volatile uint32_t g_ticks;

void delayMS(uint32_t n)
{
		g_ticks = n;
		while(g_ticks);
}

int main()
{
    uint32_t msCnt;    // count value of 1ms
    uint32_t i;
    //-----------------------------------------------------------------------
    // Systick setting
    //-----------------------------------------------------------------------
    SystemCoreClockUpdate();
    msCnt = SystemCoreClock / 1000;
    SysTick_Config(msCnt);

		GPIO_Init(PORT0,PIN1,OUTPUT);
		PORT_SetBit(PORT0,PIN1);
    //-----------------------------------------------------------------------
    // Configure Option Byte C0H to enable WDT in system_CMS32M6510.c
    //-----------------------------------------------------------------------
		while(1)
		{
			PORT_ToggleBit(PORT0,PIN1);
			delayMS(2);
			/**********SLEEP MODE**************/
			for (i = 0; i < 8; i++)
			{
					__HALT();   /* Sleep */
			}
		}
    
}

/***********************************************************************************************************************
* Function Name: SysTick Handler
* Description  : Decreament the g_ticks value
* Arguments    : None
* Return Value : None
***********************************************************************************************************************/
void SysTick_Handler(void)
{
	UART_Lock(UART0);			//Lock when system used UART
	g_ticks--;
}


